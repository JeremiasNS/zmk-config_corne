/*
 * Copyright (c) 2020 The ZMK Contributors
 * SPDX-License-Identifier: MIT
 *
 * Scylla MK2 — lado esquerdo
 * Colunas C0–C5, col2row: saídas sem pull
 */

#include "scylla.dtsi"

&kscan0 {
    col-gpios
        = <&pro_micro 8  GPIO_ACTIVE_HIGH>   /* C0  — P1.04 */
        , <&pro_micro 9  GPIO_ACTIVE_HIGH>   /* C1  — P1.06 */
        , <&pro_micro 21 GPIO_ACTIVE_HIGH>   /* C2  — P0.31 */
        , <&pro_micro 20 GPIO_ACTIVE_HIGH>   /* C3  — P0.29 */
        , <&pro_micro 19 GPIO_ACTIVE_HIGH>   /* C4  — P0.02 */
        , <&pro_micro 18 GPIO_ACTIVE_HIGH>   /* C5  — P1.15 */
        ;
};
