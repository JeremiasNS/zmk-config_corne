## boards/shields/scylla/Kconfig.defconfig
```kconfig
# Copyright (c) 2020 The ZMK Contributors
# SPDX-License-Identifier: MIT

if SHIELD_SCYLLA_DONGLE

config ZMK_KEYBOARD_NAME
    default "Scylla"

config ZMK_SPLIT_ROLE_CENTRAL
    default y

# Set this to the number of peripherals your dongle will have.
# For a unibody, this would be 1. If you have left and right halves, set it to 2, etc.
config ZMK_SPLIT_BLE_CENTRAL_PERIPHERALS
    default 2

config ZMK_USB
    default y

config BT_MAX_CONN
    default 7

config BT_MAX_PAIRED
    default 7

endif

if SHIELD_SCYLLA_LEFT || SHIELD_SCYLLA_RIGHT || SHIELD_SCYLLA_DONGLE

config ZMK_SPLIT
    default y

endif

if SHIELD_SCYLLA_RIGHT
config EC11
    default y
endif # SHIELD_SCYLLA_RIGHT
```
